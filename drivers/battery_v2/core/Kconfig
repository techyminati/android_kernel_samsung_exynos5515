## drivers/battery_v2/core/Kconfig
```kconfig
config SB_CORE
	tristate "sb-core"
	default n
	help
	  Say Y here to enable.
	  support for sec battery core API.
	  (module: pq/notify/sysfs/vote)
	  refer to API headers.

config SB_PQUEUE
	bool "sb-pqueue"
	default n
	help
	  Say Y here to enable.
	  support for priority queue.
	  (api: push/pop/remove)
	  If you use the data type,
	  you should set the compare function.
	  refer to sb_pqueue.h

config SB_NOTIFY
	bool "sb-notify"
	default n
	help
	  Say Y here to enable.
	  support for notifier.
	  (type: probe/exit/external/others event)
	  refer to sb_notify.h

config SB_MISC
	bool "sb-misc"
	default n
	help
	  Say Y here to enable.
	  support for miscdevice(ioctl).
	  (api: read/write)
```

## drivers/battery_v2/step/Kconfig
```kconfig
config SB_STEP
	tristate "sb-step"
	default n
	help
		Say Y here to enable.
		support for sec battery step API.
		refer to API headers.

config SB_STEP_WATCH5
	tristate "use Step Charging for Watch5"
	default n
	depends on SB_STEP
	help
		Say Y to use Step Charging for Watch5
		made by PSG.
```

## drivers/bts/Kconfig
```kconfig
#
# BTS device driver Kernel Configuration
#

menuconfig EXYNOS_BTS
	bool "BTS device driver support"
	default n
	help
	  Enables BTS(Bus Traffic Shaper) device driver support
	  BTS device driver will set BTS and request DVFS for
	  controlling system bus traffic. Default setting of BTS
	  should be different to chipset because of hardware characteristics.

if EXYNOS_BTS

config S5E5515_BTS
        bool "Bus traffic shaper support for s5e5515"
        default n
        depends on SOC_S5E5515
        help
          Enable BTS (Bus traffic shaper) support for S5E5515 SOC

endif
```

## drivers/gpu/arm/Kconfig
```kconfig
#
# (C) COPYRIGHT 2012-2013 ARM Limited. All rights reserved.
#
# This program is free software and is provided to you under the terms of the
# GNU General Public License version 2 as published by the Free Software
# Foundation, and any use by you of this program is subject to the terms
# of such GNU licence.
#
# A copy of the licence is included with the program, and can also be obtained
# from Free Software Foundation, Inc., 51 Franklin Street, Fifth Floor,
# Boston, MA  02110-1301, USA.
#
#

menu "ARM GPU Configuration"

choice
	prompt "Mali Version Configuration"
	default MALI_DDK_NONE
	help
	  Select the gpu support version.

config MALI_DDK_NONE
    bool "None"

config MALI_VALHALL_R26P0_R
	bool "Valhall r26p0 driver"

endchoice

if MALI_VALHALL_R26P0_R
source "drivers/gpu/arm/bv_r26p0/Kconfig"
endif

endmenu
```

## drivers/gud/Kconfig
```kconfig
#
# Mobicore Configuration
#

if SOC_S5E5515
source "drivers/gud/gud-s5e5515/Kconfig"
endif
```

## drivers/input/touchscreen/hideep/Kconfig
```kconfig
config TOUCHSCREEN_HIDEEP_IST207W
	tristate "HiDeep Touch IC"
	depends on I2C
	help
	  Say Y here if you have a touchscreen using HiDeep.

	  If unsure, say N.
	  To compile this driver as a module, choose M here: the
	  module will be called hideep.
```

## drivers/input/touchscreen/zinitix/ztm620/Kconfig
```kconfig
#
# Zinitix Touchscreen driver configuration
#

config TOUCHSCREEN_ZINITIX_ZTM620
        tristate "Zinitix ZTM620 touchscreen"
        depends on I2C
        help
         Say Y here if you want support for ZINITIX_ZTM620 touchscreen controllers.
         To compile this driver as a module, choose M here: the
         module will be called ZXT_ZTM620.

config INPUT_TOUCHSCREEN_BEZEL
        tristate "bezel wheel"
        help
         Say Y here if you want use touchscreen bezel wheel controllers.
```

## drivers/input/touchscreen/zinitix/ztm630/Kconfig
```kconfig
#
# Zinitix Touchscreen driver configuration
#

config TOUCHSCREEN_ZINITIX_ZTM630
        tristate "Zinitix ZTM630 touchscreen"
        depends on I2C
        help
         Say Y here if you want support for ZINITIX_ZTM630 touchscreen controllers.
         To compile this driver as a module, choose M here: the
         module will be called ZXT_ZTM630.

config INPUT_TOUCHSCREEN_BEZEL
        tristate "bezel wheel"
        help
         Say Y here if you want use touchscreen bezel wheel controllers.
```

## drivers/input/touchscreen/zinitix/ztm730/Kconfig
```kconfig
#
# Zinitix Touchscreen driver configuration
#

config TOUCHSCREEN_ZINITIX_ZTM730
        tristate "Zinitix ZTM730 touchscreen"
        depends on I2C
        help
         Say Y here if you want support for ZINITIX_ZTM730 touchscreen controllers.
         To compile this driver as a module, choose M here: the
         module will be called ZXT_ZTM730.

config INPUT_TOUCHSCREEN_BEZEL
        tristate "bezel wheel"
        help
         Say Y here if you want use touchscreen bezel wheel controllers.
```

## drivers/muic/Kconfig
```kconfig
#
# MUIC devices
#

comment "MUIC configs"

config USE_MUIC
	bool "Using MUIC device driver"
	depends on I2C
	default n
	help
	  If you say yes here you will get support for
	  the MUIC device driver.

config MUIC_NOTIFIER
	bool "MUIC notifier support"
	depends on USE_MUIC
	default n
	help
	  If you say yes here you will get support for
	  the MUIC attached device status change notification.
```

## drivers/sensorhub/Kconfig
```kconfig
menu "Sensor HUB Drivers"

#
# sensor drivers configuration
#
config SENSORS_SSP_WISE
	bool "Watch 4"
	default N
	help
	  Include Watch4 firmware

config SENSORS_SSP_FRESH
	bool "Active 4"
	default N
	help
	  Include Active4 firmware

config SENSORS_SSP_HEART
	bool "Watch 5"
	default N
	help
	  Include Watch5 firmware

config CONTEXTHUB_DRV
	tristate "chub driver"
	default n
	help
	  chub driver

source "drivers/sensorhub/slsi/Kconfig"
endmenu
```

## drivers/sensorhub/slsi/Kconfig
```kconfig
#
# sensor drivers configuration
#
config SENSORS_SYSFS
	tristate "Sensors sysfs"
	default n
	help
	  Support sysfs for sensors.
          If you say yes here you get sysfs support for
	  sensor factory test.
	  To compile this driver as a module, choose M here: the
	  module will be called sensors_core.

config SENSORS_SSP
	tristate "Sensors ssp"
	default n
	depends on SPI
	help
	  ssp driver for sensor hub.
          If you say yes here you get ssp support for
	  sensor hub.
	  To compile this driver as a module, choose M here: the
	  module will be called ssp.

config SENSORS_SSP_CHUB
	tristate "Sensors ssp chub"
	default n
	depends on SPI
	help
	  ssp driver for sensor hub.
          If you say yes here you get ssp support for
	  sensor hub.
	  To compile this driver as a module, choose M here: the
	  module will be called ssp.

config SENSORS_SSP_SENSORHUB
	tristate "Sensors ssp sensorhub"
	default n
	depends on SPI
	help
	  ssp sensor hub driver for sensor hub.
          If you say yes here you get ssp support for
	  sensor hub.
	  To compile this driver as a module, choose M here: the
	  module will be called ssp.

config SENSORS_SSP_FACTORY
	tristate "ssp factory"
	depends on SENSORS_SSP
	default n
	help
	  ssp sensor hub driver for factory test.
          If you say yes here you can enable fatory drvier for
	  factory test.
	  To compile this driver as a module, choose M here: the
	  module will be called ssp.

config SENSORS_SSP_ACCELEROMETER_SENSOR
	tristate "Sensors ssp acceleromter sensor"
	default n
	depends on SPI
	help
          If you say yes here, accelererometer sensor supported
	  To compile this driver as a module, choose M here: the
	  module will be called ssp.

config SENSORS_SSP_ACCELEROMETER_32GSENSOR
	tristate "Sensors ssp acceleromter 32g sensor"
	default n
	depends on SPI
	help
          Sensors ssp acceleromter 32g sensor.

config SENSORS_SSP_LINEAR_ACCELEROMETER_SENSOR
	tristate "Sensors ssp linear acceleromter sensor"
	default n
	depends on SPI
	help
          Sensors ssp linear acceleromter sensor.

config SENSORS_SSP_GYRO_SENSOR
	tristate "Sensors ssp gyro sensor"
	default n
	depends on SPI
	help
          If you say yes here, gyro sensor supported
	  To compile this driver as a module, choose M here: the
	  module will be called ssp.

config SENSORS_SSP_MAGNETIC_SENSOR
	tristate "Sensors ssp magnetic sensor"
	default n
	depends on SPI
	help
          If you say yes here, magnetic sensor supported
	  To compile this driver as a module, choose M here: the
	  module will be called ssp.

config SENSORS_SSP_PRESSURE_SENSOR
	tristate "Sensors ssp pressure sensor"
	default n
	depends on SPI
	help
          If you say yes here, pressure sensor supported
	  To compile this driver as a module, choose M here: the
	  module will be called ssp.

config SENSORS_SSP_LIGHT_SENSOR
	tristate "Sensors ssp light sensor"
	default n
	depends on SPI
	help
          If you say yes here, light sensor supported
	  To compile this driver as a module, choose M here: the
	  module will be called ssp.

config SENSORS_SSP_OPT3007
	tristate "Sensors ssp OPT3007"
	default n
	depends on SPI
	help
          If you say yes here, light sensor supported
	  To compile this driver as a module, choose M here: the
	  module will be called ssp.

config SENSORS_SSP_TEMP_HUMID_SENSOR
	tristate "Sensors ssp temp_humid sensor"
	default n
	depends on SPI
	help
          If you say yes here, temp_humid sensor supported
	  To compile this driver as a module, choose M here: the
	  module will be called ssp.
config SENSORS_SSP_SKIN_TEMP
	tristate "Sensors ssp skin temp sensor"
	depends on SPI
	help
	  If you say yes here, skin temp sensor supported
	  Two temp sensor will be working
config SENSORS_SSP_ROT_VECTOR_SENSOR
	tristate "Sensors ssp rotation vector sensor"
	default n
	depends on SPI
	help
          If you say yes here, rotation vector sensor supported
	  To compile this driver as a module, choose M here: the
	  module will be called ssp.

config SENSORS_ECG_LIB
	tristate "Sensors ssp ecg lib"
	default n
	depends on SPI
	help
          Sensors ssp ecg lib

config SENSORS_SSP_BIA_SENSOR
	tristate "Sensors ssp bia"
	default n
	depends on SPI
	help
          Sensors ssp bia

config SENSORS_SSP_HRM_SENSOR
	tristate "Sensors ssp hrm sensor"
	default n
	depends on SPI
	help
          If you say yes here, hrm sensor supported
	  To compile this driver as a module, choose M here: the
	  module will be called ssp.

config SENSORS_SSP_HRM_ECG_SENSOR
	tristate "Sensors ssp ecg hrm sensor"
	default n
	depends on SPI
	help
          If you say yes here, hrm sensor supported
	  To compile this driver as a module, choose M here: the
	  module will be called ssp.

config SENSORS_SSP_UV_SENSOR
	tristate "Sensors ssp uv sensor"
	default n
	depends on SPI
	help
          If you say yes here, uv sensor supported
	  To compile this driver as a module, choose M here: the
	  module will be called ssp.

config SENSORS_SSP_FRONT_HRM_SENSOR
	tristate "Sensors ssp front hrm sensor"
	default n
	depends on SPI
	help
          If you say yes here, front hrm sensor supported
	  To compile this driver as a module, choose M here: the
	  module will be called ssp.

config SENSORS_SSP_GSR_SENSOR
	tristate "Sensors ssp gsr sensor"
	default n
	depends on SPI
	help
          If you say yes here, gsr sensor supported
	  To compile this driver as a module, choose M here: the
	  module will be called ssp.

config SENSORS_SSP_ECG_SENSOR
	tristate "Sensors ssp ecg sensor"
	default n
	depends on SPI
	help
          If you say yes here, ecg sensor supported
	  To compile this driver as a module, choose M here: the
	  module will be called ssp.

config SENSORS_SSP_GRIP_SENSOR
	tristate "Sensors ssp grip sensor"
	default n
	depends on SPI
	help
          If you say yes here, grip sensor supported
	  To compile this driver as a module, choose M here: the
	  module will be called ssp.

config SENSORS_SSP_LPM_MOTION
	tristate "Sensors ssp lpm motion"
	default n
	depends on SPI
	help
          If you say yes here, lpm motion supported
	  To compile this driver as a module, choose M here: the
	  module will be called ssp.

config SENSORS_SSP_HALLIC_SENSOR
	tristate "Sensors ssp hall ic sensor"
	default n
	depends on SPI
	help
          If you say yes here, hall ic sensor supported
	  To compile this driver as a module, choose M here: the
	  module will be called ssp.

config SENSORS_SSP_INPUT_DEV
	tristate "Sensors input device"
	default n
	help
	  Support input device.

config SENSORS_SSP_VIB_NOTIFY
	tristate "Sensors vibrator notifier"
	default n
	help
	  Support vibrator notifier.

config SENSORS_SSP_AP_WAKEUP
	tristate "Sensors ap wakeup support"
	default n
	help
	  Support ap wakeup.

config SENSORS_SSP_HRM_ADI
	tristate "Sensors ADI HRM sensor support"
	default n
	help
	  Support ADI HRM sensor.

config SENSORS_SSP_THERMISTOR_SENSOR
	tristate "Sensors ssp thermistor sensor"
	default n
	depends on SPI
	help
          If you say yes here, thermistor sensor supported
	  To compile this driver as a module, choose M here: the
	  module will be called ssp.

config SENSORS_SSP_TEMPERATURE_SENSOR
	tristate "Sensors ssp temperature sensor"
	default n
	depends on SPI
	help
          Sensors ssp temperature lib
          
config SENSORS_SSP_MAGNETIC_32BIT
	tristate "Sensors ssp magnetic 32bit"
	default n
	depends on SPI
	help
          Sensors ssp magnetic 32bit

config SENSORS_SSP_DEBUG
	tristate "Sensors ssp debug"
	default n
	depends on SPI
	help
          If you say yes here, ssp debug supported

source "drivers/sensorhub/slsi/factory/Kconfig"
```
