## drivers/soc/samsung/Kconfig
```kconfig
# SPDX-License-Identifier: GPL-2.0
#
# SAMSUNG SoC drivers
#
menuconfig SOC_SAMSUNG
	bool "Samsung SoC driver support" if COMPILE_TEST

if SOC_SAMSUNG

config EXYNOS_PMU
	bool "Exynos Power Management Unit Driver Support"
	depends on ARCH_EXYNOS
	select MFD_SYSCON

config EXYNOS_PM_DOMAINS
	bool "Exynos PM domains" if COMPILE_TEST
	depends on PM_GENERIC_DOMAINS || COMPILE_TEST

source "drivers/soc/samsung/acpm/Kconfig"
config EXYNOS_CHIPID
	bool "Exynos Chipid controller driver"
	depends on ARCH_EXYNOS
	select SOC_BUS

config USI_V2
	bool "Enable Universal Serial Interface version 2"
	default y

config ECT
	bool "Enable Exynos Characteristic Table File"
	default n
	depends on ARCH_EXYNOS

config ECT_DUMP
	bool "Enable Exynos Characteristic Table File Dump sysfs"
	default n
	depends on ECT

config EXYNOS_PD
	bool "Exynos PM domain Support"
	depends on ARCH_EXYNOS
	depends on PM
	select PM_GENERIC_DOMAINS

config EXYNOS_CPUPM
	bool "Exynos CPU Power Management driver"
	depends on ARCH_EXYNOS && EXYNOS_PMU && PMUCAL
	help
	Support Exynos CPU Power Control for EXYNOS SoC.

config EXYNOS_RGT
	bool "Exynos Regulator Debug Support"
	depends on REGULATOR
	depends on DEBUG_FS
	depends on OF
	help
	  dummy device driver for debugging samsung PMIC

config EXYNOS_BCM
	bool "EXYNOS_BCM driver support"
	default n
	help
	  Enable exynos_bcm driver support

config CAL_IF
	bool "Exynos Chip Abstraction Layer Interface"
	help
	  Support CMU CAL for Exynos SoC.

config EXYNOS_PM_DVS
       bool "Enable Exynos dynamic voltage setting"
       default n

config PMUCAL
	bool "Exynos PMU Chip Abstraction Layer"
	depends on CAL_IF
	default y
	help
	 Support PMUCAL for Exynos SoC.

config CHUB_PMUCAL
        bool "Exynos PMU(for SHUB) Chip Abstraction Layer"
        default n
        depends on CAL_IF
        help
        Support CHUB_PMUCAL for Exynos SoC.

config FLEXPMU
	bool "Exynos FLEXPMU"
	depends on PMUCAL
	default n
	help
	 Support PMUCAL for Exynos SoC.

config EXYNOS_FLEXPMU_DBG
	bool "Exynos FLEXPMU DBG"
	depends on FLEXPMU
	default y
	help
	 Support FLEXPMU for Exynos SoC.

config CMUCAL
	bool "Exynos CMU Chip Abstraction Layer"
	depends on CAL_IF
	default y
	help
	  Support CMUCAL for Exynos SoC.
config CP_PMUCAL
	bool "Exynos PMU(for CP) Chip Abstraction Layer"
	depends on CAL_IF
	help
	Support CP_PMUCAL for Exynos SoC.

config GNSS_PMUCAL
	bool "Exynos PMU(for GNSS) Chip Abstraction Layer"
	depends on CAL_IF
	help
	  Support GNSS_PMUCAL for Exynos SoC.

config CMUCAL_DEBUG
	bool "CMUCAL Debug Interface"
	depends on CMUCAL

config CMUCAL_QCH_IGNORE_SUPPORT
	bool "CMUCAL QCH IGNORE Support"
	depends on CMUCAL

config ACPM_DVFS
	bool "Exynos ACPM DVFS manager"
	depends on CAL_IF && CMUCAL
	default y
	help
	  Support ACPM DVFS for Exynos SoC.

source "drivers/soc/samsung/cpif/Kconfig"
source "drivers/soc/samsung/gnssif/Kconfig"

config EXYNOS_DVFS_MANAGER
	bool "Exynos DVFS Manager"
	default n
	depends on ARCH_EXYNOS
	help
	  Enable DVFS Manager for Exynos SoC.
	  This module controls constraint between each DVFS domains.

config EXYNOS_MEMORY_LOGGER
	tristate "Exynos Memory Logger"
	default n
	help
	  Exynos Memory Logger API is provided by memlog driver.

	  Memlog means exynos memory Logger driver. The memlog provides
	  the logging method desired by each driver in memory for debugging,
	  memlog provides APIs for memory logging.

config EXYNOS_SYSTEM_EVENT
	tristate "Exynos System Event Framework"
	default n
	help
	  Enable System Event Framework for Exynos SoC.

config EXYNOS_IMGLOADER
	tristate "Exynos Image Loader"
	default n
	help
	  Enable Image Loader for Exynos SoC.

config EXYNOS_SDM
	tristate "Exynos Security Dump Manager Support"
	depends on DEBUG_SNAPSHOT
	default y
	help
	  Exynos Security Dump Manager

config EXYNOS_SECURE_LOG
	tristate "Exynos Secure Log"
	default y
	help
	  Support Exynos Secure Log

config EXYNOS_TZASC_FAIL_DETECTOR
	bool "Exynos TZASC Fail Detector"
	default y
	help
	  Support Exynos TZASC Fail Detector

config EXYNOS_TZASC_ILLEGAL_READ_LOGGING
	bool "Logging TZASC Read Fail Information"
	depends on EXYNOS_TZASC_FAIL_DETECTOR
	default n
	help
	  TZASC fail information of illegal reads will be printed
	  by the Kernel logging system.

config EXYNOS_TZASC_ILLEGAL_ACCESS_PANIC
	bool "Kernel Panic over TZASC Illegal Access"
	depends on EXYNOS_TZASC_FAIL_DETECTOR
	default y
	help
	  Kernel panic will occur in case that TZASC illegal
	  access is detected.

config EXYNOS_KERNEL_PROTECTION
        bool "Exynos Kernel Code Protection"
	default y
        help
          Support Exynos Kernel Code Protection

source "drivers/soc/samsung/debug/Kconfig"
config EXYNOS_BCM_DBG
        tristate "EXYNOS_BCM_DBG driver support"
        help
          Enable exynos-bcm_dbg driver support

config EXYNOS_BCM_DBG_GNR
        tristate "EXYNOS_BCM_DBG_GNR driver support"
        help
          Enable exynos-bcm_dbg driver support

config EXYNOS_BCM_DBG_DUMP
        tristate "EXYNOS_BCM_DBG dump support"
        depends on EXYNOS_BCM_DBG
        help
          Enable exynos-bcm_dbg dump support

endif
```

## drivers/soc/samsung/debug/Kconfig
```kconfig
menuconfig EXYNOS_DEBUG
        bool "Exynos Debug Features"
        default n

if EXYNOS_DEBUG
menuconfig DEBUG_SNAPSHOT
	tristate "Debug SnapShot Support"
	depends on EXYNOS_DEBUG
	default n

config DEBUG_SNAPSHOT_FREQ_DOMAIN_NUM
	int "Number of freq logging domain type"
	depends on DEBUG_SNAPSHOT
	range 4 32
	default 32

config DEBUG_SNAPSHOT_LOG_ITEM_SIZE
	int "Number of logging item base size"
	depends on DEBUG_SNAPSHOT
	range 256 1024
	default 1024

config DEBUG_SNAPSHOT_SFRDUMP
	tristate "Debug Snapshot SFRDUMP"
	depends on DEBUG_SNAPSHOT
	default n

config DEBUG_SNAPSHOT_QUICKDUMP
	tristate "Debug Snapshot quickdump"
	depends on DEBUG_SNAPSHOT
	default n

config EXYNOS_ITMON
        bool "Exynos IPs Traffic Monitor"
        depends on EXYNOS_DEBUG

config EXYNOS_DEBUG_TEST
        tristate "Exynos debug feature test"
        depends on DEBUG_SNAPSHOT
        default n

config EXYNOS_HARDLOCKUP_WATCHDOG
	tristate "Exynos Hardlockup Watchdog"
	depends on DEBUG_SNAPSHOT
	default n

config EXYNOS_CORESIGHT
        tristate "Enable Coresight of exynos"
	depends on DEBUG_SNAPSHOT
        default n
	help
	  This is support to show PC values of each cpus when kernel panic
	  caused by hard lockup.

config EXYNOS_ECC_HANDLER
	tristate "Exynos support ECC handler"
	depends on DEBUG_SNAPSHOT
	default n
	help
	  If ECC happened in cache of CPU, interrupt occurs to cpu.

config EXYNOS_ADV_TRACER
        tristate "Exynos Advanced Tracer"
        depends on EXYNOS_DEBUG
        default n

config EXYNOS_ADV_TRACER_S2D
        tristate "Exynos Advanced Tracer: Plug-in - S2D"
        depends on EXYNOS_ADV_TRACER
        default n

config EXYNOS_SSLD
        tristate "Exynos support S2R Scenario Lockup Detector"
        depends on EXYNOS_DEBUG
        default n
endif
```

## drivers/soc/samsung/gnssif/Kconfig
```kconfig
config EXYNOS_GNSS_IF
	bool "Exynos GNSS interface driver"
	default n
	---help---
	  Exynos GNSS interface driver

if EXYNOS_GNSS_IF

menu "Configuration Description"
config GNSS_ACTIVE_WA
	bool "GNSS ACTIVE WA"
	default n
	help
	   This feature let GNSS driver to disable wakeup source (GNSS_ACTIVE)
	   from gnss, since its hardware init value continuously wakes up PMU
	   This wakeup source is enabled when GPSD finishes booting gnss firmware,
	   which will reset GNSS_ACTIVE from 0 to 1.
endmenu
endif
```

## drivers/staging/lpd/Kconfig
```kconfig
# drivers/staging/lpd/Kconfig
#
# Copyright (c) 2010-2011 Samsung Electronics Co., Ltd.
#		http://www.samsung.com/
#
# Licensed under GPLv2

config EXYNOS_LPD
	tristate "Samsung Exynos Low Power Display"
	default N
	help
	  Enable support for Exynos Low Power Display mode.

config MCD_LPD_V1
	tristate "MX Low Power Display V1"
	depends on EXYNOS_LPD
	default N
	help
	  Enable support for MX Low Power Display mode V1.
```

## drivers/staging/lpd_v2/Kconfig
```kconfig
# drivers/staging/lpd/Kconfig
#
# Copyright (c) 2010-2011 Samsung Electronics Co., Ltd.
#		http://www.samsung.com/
#
# Licensed under GPLv2

config MCD_LPD_V2
	tristate "MX Low Power Display V2"
	depends on EXYNOS_LPD
	default N
	help
	  Enable support for MX Low Power Display mode V2.
```

## drivers/staging/nanohub/Kconfig
```kconfig
config NANOHUB
	tristate "Nanohub"
	default N
	select IIO
	select CONTEXTHUB_DRV
	help
	  Enable support for the nanohub sensorhub driver.

	  This driver supports the android nanohub sensorhub.

	  If in doubt, say N here.

if NANOHUB

config NANOHUB_SPI
	bool "Nanohub SPI"
	default N
	help
	  Enable nanohub SPI support.

	  Either this or NANOHUB_I2C should be selected.

	  If in doubt, say Y here.

config NANOHUB_I2C
	bool "Nanohub I2C"
	default N
	help
	  Enable nanohub I2C support.

	  Either this or NANOHUB_SPI should be selected.

	  If in doubt, say N here.

config NANOHUB_MAILBOX
	bool "Nanohub Mailbox"
	default Y
	help
	  Enable nanohub Mailbox support.

	  Either this or NANOHUB_MAILBOX should be selected.

	  If in doubt, say N here.

config CONTEXTHUB_DRV
	bool "Contexthub driver"
	default Y
	help
	  Enable contexthub driver

config SENSOR_DRV
	bool "Sensor driver to support exynos sensor Hal"
	default N
	help
	  Enable sensorhub hal support.

config CONTEXTHUB_DEBUG
	bool "Nanohub debug"
	default N
	help
	  Enable nanohub device debug message

config CONTEXTHUB_SENSOR_DEBUG
	bool "Nanohub sensor debug"
	default N
	help
	  Enable nanohub seneor alive check

config SENSORS_SSP_HRM_ADI
	tristate "ADI HRM sensor support"
	default N
	help
	  Support ADI HRM sensor.

config SENSORS_SSP_DEBUG
	bool "ssp sensor debug"
	default N
	help
	  Enable ssp sensor debug message
endif # NANOHUB
```

## drivers/vibrator/Kconfig
```kconfig
source "drivers/vibrator/common/Kconfig"

source "drivers/vibrator/hideep/Kconfig"
```

## drivers/vibrator/hideep/Kconfig
```kconfig
#
# motor drivers configuration
#

config MOTOR_DRV_IST207W
	tristate "IST207W motor"
	default n
	depends on I2C
	help
	 Say Y to enable the ist207w motor driver
```

## drivers/video/fbdev/exynos/Kconfig
```kconfig
if SOC_S5E5515

source "drivers/video/fbdev/exynos/dpu30/Kconfig"
source "drivers/video/fbdev/exynos/mcd_panel/Kconfig"

endif # SOC_S5E5515
```

## drivers/video/fbdev/exynos/mcd_panel/Kconfig
```kconfig
config MCD_PANEL
	tristate "Samsung MCD Panel Driver"
	select BACKLIGHT_CLASS_DEVICE
	default n
	help
		Enable MCD Panel Driver.

config EXYNOS_DECON_MDNIE_LITE
	bool "Support MDNIE LITE"
	depends on MCD_PANEL
	default n

config SUPPORT_AFC
	bool "Support AFC"
	depends on MCD_PANEL && EXYNOS_DECON_MDNIE_LITE
	default n

config EXYNOS_DECON_LCD_SYSFS
	bool "Support LCD SYSFS"
	depends on MCD_PANEL
	default n

config DISPLAY_VRR
	bool "Support VRR feature"
	depends on MCD_PANEL
	default n

config EXYNOS_DECON_LCD_TUNING
	bool "Support LCD TUNING"
	depends on MCD_PANEL
	default n

config PANEL_AID_DIMMING
	bool "Support AID Dimming"
	depends on MCD_PANEL
	default y
	default n

config SUPPORT_AOD_BL
	bool "Support AOD(Active On Display) BL(BackLight) Driver"
	depends on MCD_PANEL && EXYNOS_DOZE
	default n

config SUPPORT_DISPLAY_PROFILER
	bool "Support Display Profiler"
	depends on MCD_PANEL
	default n

config SUPPORT_DIM_FLASH
	bool "Support display dimming flash"
	depends on MCD_PANEL && SUPPORT_DDI_FLASH
	default n

config SUPPORT_GRAM_CHECKSUM
	bool "Support GRAM Checksum"
	depends on MCD_PANEL
	default n

config SUPPORT_CCD_TEST
	bool "Support CCD TEST"
	depends on MCD_PANEL
	default n

config SUPPORT_DYNAMIC_HLPM
	bool "Support Dynamic HLPM TEST"
	depends on MCD_PANEL && EXYNOS_DOZE
	default n

config PANEL_BACKLIGHT_PAC_3_0
	bool "Support baclight PAC 3.0"
	depends on MCD_PANEL
	default n

config DISPLAY_USE_INFO
	bool "Support display use info logging"
	depends on MCD_PANEL
	default n

config PANEL_NOTIFY
	bool "Support panel notifier"
	depends on MCD_PANEL
	default n

config SUPPORT_POC_SPI
	bool "Support poc SPI connection"
	depends on MCD_PANEL
	default n

config SUPPORT_GM2_FLASH
	bool "Support to get Gamma-mode2 panel info from flash"
	depends on MCD_PANEL
	default n

config DYNAMIC_MIPI
	bool "Support Dynamic Mipi"
	depends on MCD_PANEL
	default n

config PANEL_DISPLAY_MODE
	bool "Support panel display mode"
	depends on MCD_PANEL
	default n

config EXYNOS_LCD_ENG
	bool "Support LCD featue on ENG binary"
	depends on MCD_PANEL
	default n

config PANEL_DEBUG
	bool "Support panel debug"
	depends on MCD_PANEL
	default n

config SUPPORT_MASK_LAYER
	bool "Support FP mask layer function"
	depends on MCD_PANEL
	default n

config SUPPORT_ERRFG_RECOVERY
	bool "Support ERRFG recovery"
	depends on MCD_PANEL
	default n

config SUPPORT_BRIGHTDOT_TEST
	bool "Support Brightdot Test"
	depends on MCD_PANEL
	default n

config EVASION_DISP_DET
    bool "Support avoid disp_det interrupt"
    depends on MCD_PANEL
    default n

source "drivers/video/fbdev/exynos/mcd_panel/s6e36w4x01/Kconfig"
source "drivers/video/fbdev/exynos/mcd_panel/s6e36w5x01/Kconfig"
source "drivers/video/fbdev/exynos/mcd_panel/rm69091/Kconfig"
```

## drivers/video/fbdev/exynos/mcd_panel/rm69091/Kconfig
```kconfig
menuconfig DISPLAY_RM69091
	tristate "RM69091 DDI Panel Driver"
	depends on MCD_PANEL && EXYNOS_MIPI_DSIM
	help
		This enables RM69091 DDI dependent panel drivers of
		common panel driver. say Y, if you have a panel based on
		the RM69091 DDI.
```

## drivers/video/fbdev/exynos/mcd_panel/s6e36w5x01/Kconfig
```kconfig
menuconfig DISPLAY_S6E36W5X01
	tristate "S6E36W5X01 DDI Panel Driver"
	depends on MCD_PANEL && EXYNOS_MIPI_DSIM
	help
		This enables S6E36W5X01 DDI dependent panel drivers of
		common panel driver. say Y, if you have a panel based on
		the S6E36W4X01 DDI.
```
