/*
 * Samsung Exynos SoC series Panel driver
 *
 * Copyright (c) 2020 Samsung Electronics Co., Ltd
 *
 * This program is free software; you can redistribute it and/or modify
 * it under the terms of the GNU General Public License version 2 as
 * published by the Free Software Foundation.
 */

/ {
	fragment@panel_drv {
		target-path = "/";
		__overlay__ {
			rm69091_large: rm69091_ddi_large {
				id = <0x842440>;
				mode = <2>; /* 0: video mode, 1: DP command mode, 2: MIPI command mode */
				resolution = <450 450>;
				size = <35 35>;
				timing,refresh = <60>;
				timing,h-porch = <20 64 2>; /* dsim H porch : hbp, hfp, hsa */
				timing,v-porch = <24 22 2>; /* dsim V porch : VBP, VFP, VSA */
				timing,dsi-hs-clk = <384>;
				timing,pmsk = <0x02 0xEC 0x4 0x4EC5>;
				timing,dsi-escape-clk = <12>;
				mic_en = <0>; /* 0: Disable, 1: Enable */
				mic_ratio = <2>;		/* 0: 1/2 mic, 1: 1/3 mic */
				mic_ver = <2>;			/* 0: mic v1.1, 1: v1.2, 2: v2.0 */
				type_of_ddi = <2>;		/* 0: Samsung Mobile, 1: MAGNA, 2: Normal(Etc) */
				dsc_en = <0>;			/* 0: Disable, 1: Enable */
				dsc_cnt = <2>;			/* used DSC count */
				dsc_slice_num = <2>;		/* count of dsc slice */
				dsc_slice_h = <120>;		/* height of dsc slice */
				data_lane = <1>;		/* number of using data lane */
				cmd_underrun_cnt = <668>;	/* for underrun detect*/
				mres_en = <0>;

				hdr_num = <0>;			/* max: 4 */
				hdr_type = <2 3 0 0>;		/* 1: DOLBY_VISION, 2: HDR10, 3: HLG */
				hdr_max_luma = <4500000>;	/* 450 */
				hdr_max_avg_luma = <1200000>;	/* 120 */
				hdr_min_luma = <5>;		/* 0.0005 */
				color_mode = <0 7 9>;  /* color mode : NATIVE, SRGB, P3 */

				default_mode = <0>;
				/* <xres : yres : fps : lp_ref : dsc_en : slice_w : slice_h> */
				display_mode = <450 450 60 668 0 360 74>;
			};

			rm69091_small: rm69091_ddi_small {
				id = <0x842440>;
				mode = <2>; /* 0: video mode, 1: DP command mode, 2: MIPI command mode */
				resolution = <396 396>;
				size = <30 30>;
				timing,refresh = <60>;
				timing,h-porch = <20 64 2>; /* dsim H porch : hbp, hfp, hsa */
				timing,v-porch = <24 22 2>; /* dsim V porch : VBP, VFP, VSA */
				timing,dsi-hs-clk = <384>;
				timing,pmsk = <0x02 0xEC 0x4 0x4EC5>;
				timing,dsi-escape-clk = <12>;
				mic_en = <0>; /* 0: Disable, 1: Enable */
				mic_ratio = <2>;		/* 0: 1/2 mic, 1: 1/3 mic */
				mic_ver = <2>;			/* 0: mic v1.1, 1: v1.2, 2: v2.0 */
				type_of_ddi = <2>;		/* 0: Samsung Mobile, 1: MAGNA, 2: Normal(Etc) */
				dsc_en = <0>;			/* 0: Disable, 1: Enable */
				dsc_cnt = <2>;			/* used DSC count */
				dsc_slice_num = <2>;		/* count of dsc slice */
				dsc_slice_h = <120>;		/* height of dsc slice */
				data_lane = <1>;		/* number of using data lane */
				cmd_underrun_cnt = <1355>;	/* for underrun detect*/
				mres_en = <0>;

				hdr_num = <0>;			/* max: 4 */
				hdr_type = <2 3 0 0>;		/* 1: DOLBY_VISION, 2: HDR10, 3: HLG */
				hdr_max_luma = <4500000>;	/* 450 */
				hdr_max_avg_luma = <1200000>;	/* 120 */
				hdr_min_luma = <5>;		/* 0.0005 */
				color_mode = <0 7 9>;  /* color mode : NATIVE, SRGB, P3 */

				default_mode = <0>;
				/* <xres : yres : fps : lp_ref : dsc_en : slice_w : slice_h> */
				display_mode = <396 396 60 1355 0 360 74>;
			};
		};
	};
};
