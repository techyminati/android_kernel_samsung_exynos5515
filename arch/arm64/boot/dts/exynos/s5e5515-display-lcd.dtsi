/*
 * SAMSUNG LCD Panel Device Tree Source
 *
 * Copyright (c) 2017 Samsung Electronics Co., Ltd.
 *		http://www.samsung.com
 *
 * This program is free software; you can redistribute it and/or modify
 * it under the terms of the GNU General Public License version 2 as
 * published by the Free Software Foundation.
 */

/ {
	fragment@lcd {
		target-path = "/";
		__overlay__ {
			emul_display: emul_display {
				mode = <0>; /* 0: video mode, 1: DP command mode, 2: MIPI command mode */
				resolution = <320 240>;
		/*		resolution = <1080 1920>; */
				size = <80 120>;
				timing,refresh = <60>;
				timing,h-porch = <20 20 20>;
				timing,v-porch = <20 20 20>;
				timing,dsi-hs-clk = <600>;
				/* TODO : pmsk value to be set */
				timing,pmsk = <1 96 2 0>;
				timing,dsi-escape-clk = <20>;
				underrun_lp_ref = <307>;
				mic_en = <0>;			/* 0: Disable, 1: Enable */
				mic_ratio = <0>;		/* 0: 1/2 mic, 1: 1/3 mic */
				mic_ver = <2>;			/* 0: mic v1.1, 1: v1.2, 2: v2.0 */
				type_of_ddi = <0>;		/* 0: Samsung Mobile, 1: MAGNA, 2: Normal(Etc) */
				dsc_en = <0>;			/* 0: Disable, 1: Enable */
				dsc_cnt = <0>;			/* used DSC count */
				dsc_slice_num = <0>;		/* count of dsc slice */
				data_lane = <4>;		/* number of using data lane */
				cmd_underrun_lp_ref = <1203>;	/* for underrun detect at command mode*/
				vt_compensation = <10731>;	/* wclk = 100MHZ, 320 x 240 for underrun detect at video mode*/
				hdr_num = <0>;			/* max: 4 */
				hdr_type = <0 0 0 0>;		/* 1: DOLBY_VISION, 2: HDR10, 3: HLG */
				hdr_max_luma = <0>;		/* 0 */
				hdr_max_avg_luma = <0>;		/* 0 */
				hdr_min_luma = <0>;		/* 0.0000 */
			};

			s6e36w4x01: s6e36w4x01 {
				id = <0x842440>;
				mode = <2>; /* 0: video mode, 1: DP command mode, 2: MIPI command mode */
				resolution = <360 360>;
				size = <33 33>;
				timing,refresh = <60>;
				timing,h-porch = <3 1 1>; /* dsim H porch : hbp, hfp, hsa */
				timing,v-porch = <6 10 1>; /* dsim V porch : VBP, VFP, VSA */
				timing,dsi-hs-clk = <384>;
				timing,pmsk = <0x02 0xEC 0x4 0x4EC5>;
				timing,dsi-escape-clk = <12>;
				mic_en = <0>; /* 0: Disable, 1: Enable */
				mic_ratio = <2>; /* 0: 1/2 mic, 1: 1/3 mic */
				mic_ver = <2>; /* 0: mic v1.1, 1: v1.2, 2: v2.0 */
				type_of_ddi = <0>; /* 0: Samsung Mobile, 1: MAGNA, 2: Normal(Etc) */
				dsc_en = <0>; /* 0: Disable, 1: Enable */
				dsc_cnt = <2>; /* used DSC count */
				dsc_slice_num = <2>; /* count of dsc slice */
				dsc_slice_h = <40>; /* height of dsc slice */
				data_lane = <1>; /* number of using data lane */
				cmd_underrun_lp_ref = <1764>; /* for underrun detect*/
				mres_en = <0>;
				mres_number = <1>;
				mres_width = <720>;
				mres_height = <1280>;
				mres_dsc_width = <360>;
				mres_dsc_height = <74>;
				mres_dsc_en = <0>;
				hdr_num = <0>;			/* not support */
				hdr_type = <0 0 0 0>;	/* not support */
				hdr_max_luma = <0>;		/* not support */
				hdr_max_avg_luma = <0>;	/* not support */
				hdr_min_luma = <0>;		/* not support */

				default_mode = <0>;
				/* <xres : yres : fps : lp_ref : dsc_en : slice_w : slice_h> */
				display_mode = <360 360 60 1625 0 360 74>;
			};
		};
	};
};
