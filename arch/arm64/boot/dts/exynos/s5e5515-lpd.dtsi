/*
 * copyright (c) 2021 samsung electronics co., ltd.
 *		http://www.samsung.com
 *
 * this program is free software; you can redistribute it and/or modify
 * it under the terms of the gnu general public license version 2 as
 * published by the free software foundation.
 */

/ {
	lpd: lpd {
		compatible = "samsung,exynos-lpd";
		memory-region = <&lpd_rmem>;
		reg = <0x0 0x10E00000 0x40000>;
		reg-names = "sram";
		power-domains = <&spd_lpddisp>;
	};
};
