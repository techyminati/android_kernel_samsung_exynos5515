/*
 * SAMSUNG S5E5515 SoC device tree source
 *
 * Copyright (c) 2021 Samsung Electronics Co., Ltd.
 *		http://www.samsung.com
 *
 * SAMSUNG S5E5515 SoC device nodes are listed in this file.
 * S5E5515 based board files can include this file and provide
 * values for board specfic bindings.
 *
 * This program is free software; you can redistribute it and/or modify
 * it under the terms of the GNU General Public License version 2 as
 * published by the Free Software Foundation.
 */

#include <dt-bindings/interrupt-controller/s5e5515.h>
#include <dt-bindings/sysmmu/sysmmu.h>

/ {
	sysmmu_dpu: sysmmu@13820000 {
		compatible = "samsung,exynos-sysmmu";
		reg = <0x0 0x13820000 0x9000>;
		interrupts = <0 INTREQ__SYSMMU_DPU_interrupt_ns IRQ_TYPE_LEVEL_HIGH>,
			     <0 INTREQ__SYSMMU_DPU_interrupt_s  IRQ_TYPE_LEVEL_HIGH>;
		qos = <15>;
		port-name = "G0, G1, VG";
		sysmmu,secure-irq;
		sysmmu,secure_base = <0x13830000>;
		sysmmu,tlb_property =
			<(SYSMMU_PORT_PREFETCH_PREDICTION_READ(0x0) | SYSMMU_BL1) SYSMMU_NOID>,
			<(SYSMMU_PORT_PREFETCH_PREDICTION_READ(0x1) | SYSMMU_BL1) SYSMMU_ID_MASK(0x1, 0xF)>,
			<(SYSMMU_PORT_PREFETCH_PREDICTION_READ(0x1) | SYSMMU_BL1) SYSMMU_ID_MASK(0x2, 0xF)>,
			<(SYSMMU_PORT_PREFETCH_PREDICTION_READ(0x1) | SYSMMU_BL1) SYSMMU_ID_MASK(0x3, 0xF)>;
		#iommu-cells = <0>;

		power-domains = <&pd_disp>;

		sysmmu,hold-rpm-on-boot;
		sysmmu,explicit-disable;
	};

	sysmmu_abox: sysmmu@13840000 {
		compatible = "samsung,exynos-sysmmu";
		reg = <0x0 0x13840000 0x9000>;
		interrupts = <0 INTREQ__SYSMMU_AUD_interrupt_ns IRQ_TYPE_LEVEL_HIGH>,
			     <0 INTREQ__SYSMMU_AUD_interrupt_s  IRQ_TYPE_LEVEL_HIGH>;
		qos = <15>;
		port-name = "ABOX";
		sysmmu,no-suspend;
		sysmmu,no-rpm-control;
		sysmmu,secure-irq;
		sysmmu,secure_base = <0x13850000>;
		sysmmu,tlb_property =
			<(SYSMMU_PORT_NO_PREFETCH_READ(0x0)      | SYSMMU_BL1) SYSMMU_NOID>,
			<(SYSMMU_PORT_NO_PREFETCH_READWRITE(0x1) | SYSMMU_BL1) SYSMMU_ID_MASK(0x1, 0x1)>;
		#iommu-cells = <0>;

		power-domains = <&pd_aud>;

		sysmmu,hold-rpm-on-boot;

	};

	sysmmu_mfcmscl: sysmmu@13C30000 {
		compatible = "samsung,exynos-sysmmu";
		reg = <0x0 0x13C30000 0x9000>;
		interrupts = <0 INTREQ__SYSMMU_MFC_interrupt_ns IRQ_TYPE_LEVEL_HIGH>,
			     <0 INTREQ__SYSMMU_MFC_interrupt_s  IRQ_TYPE_LEVEL_HIGH>;
		qos = <15>;
		port-name = "MFC, M2M";
		sysmmu,secure-irq;
		sysmmu,secure_base = <0x13C40000>;
		sysmmu,tlb_property =
			/* MFC */
			<(SYSMMU_PORT_NO_PREFETCH_READ(0x0) | SYSMMU_BL8) SYSMMU_NOID>,
			/* M2M scaler */
			<(SYSMMU_PORT_NO_PREFETCH_READWRITE(0x1) | SYSMMU_BL4) SYSMMU_ID_MASK(0x1,  0x1F)>,
			<(SYSMMU_PORT_NO_PREFETCH_READWRITE(0x1) | SYSMMU_BL1) SYSMMU_ID_MASK(0x3,  0x1F)>,
			<(SYSMMU_PORT_NO_PREFETCH_READWRITE(0x1) | SYSMMU_BL1) SYSMMU_ID_MASK(0x5,  0x1F)>,
			<(SYSMMU_PORT_NO_PREFETCH_READWRITE(0x1) | SYSMMU_BL1) SYSMMU_ID_MASK(0x7,  0x1F)>,
			<(SYSMMU_PORT_NO_PREFETCH_READWRITE(0x1) | SYSMMU_BL4) SYSMMU_ID_MASK(0x11, 0x1F)>,
			<(SYSMMU_PORT_NO_PREFETCH_READWRITE(0x1) | SYSMMU_BL1) SYSMMU_ID_MASK(0x13, 0x1F)>,
			<(SYSMMU_PORT_NO_PREFETCH_READWRITE(0x1) | SYSMMU_BL1) SYSMMU_ID_MASK(0x15, 0x1F)>;
		#iommu-cells = <0>;

		power-domains = <&pd_mfc>;

	};
};
